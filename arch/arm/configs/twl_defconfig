## arch/arm/configs/twl_defconfig
```kconfig
CONFIG_ARM=y
# CONFIG_MMU is not set
CONFIG_CPU_ARM946E=y
CONFIG_CPU_32v5=y
CONFIG_AEABI=y
CONFIG_ARM_THUMB=y
CONFIG_ARCH_TWL=y
CONFIG_MACH_NINTENDO_TWL=y
CONFIG_SET_MEM_PARAM=y
CONFIG_PHYS_OFFSET=0x02100000
CONFIG_PAGE_OFFSET=0x02100000
CONFIG_DRAM_BASE=0x02100000
CONFIG_DRAM_SIZE=0x00F00000
CONFIG_FLATMEM=y
CONFIG_EMBEDDED=y
CONFIG_EXPERT=y
CONFIG_OPTIMIZE_FOR_SIZE=y
CONFIG_PRINTK=y
CONFIG_EARLY_PRINTK=y
CONFIG_DEBUG_KERNEL=y
CONFIG_DEBUG_LL=y
CONFIG_DEBUG_TWL_EARLYFB=y
CONFIG_TTY=y
CONFIG_SERIAL_CORE=y
CONFIG_SERIAL_CORE_CONSOLE=y
CONFIG_SERIAL_EARLYCON=y
CONFIG_SERIAL_EARLYCON_NTR_NOCASH=y
# CONFIG_SMP is not set
CONFIG_TWL_INTC=y
CONFIG_TWL_TIMER=y
CONFIG_HZ_100=y
CONFIG_HZ=100
CONFIG_PREEMPT_NONE=y
CONFIG_BLK_DEV_INITRD=y
CONFIG_INITRAMFS_SOURCE=""
CONFIG_BINFMT_ELF=y
CONFIG_BINFMT_FLAT=y
CONFIG_BINFMT_ZFLAT=y
CONFIG_BINFMT_SHARED_FLAT=y
CONFIG_PROC_FS=y
CONFIG_SYSFS=y
CONFIG_TMPFS=y
CONFIG_DEVTMPFS=y
CONFIG_DEVTMPFS_MOUNT=y
```

## arch/arm/mach-twl/Kconfig
```kconfig
# SPDX-License-Identifier: GPL-2.0
#
# Drops into arch/arm/mach-twl/Kconfig.

menuconfig ARCH_TWL
	bool "Nintendo DSi"
	depends on !MMU
	select CPU_ARM946E
	help
	  Support for the Nintendo DSi handheld console.

	  The DSi has an ARM946E-S running at 133 MHz with 16 MB of main
	  RAM in DSi mode. Linux runs only on the ARM9; the ARM7TDMI
	  remains a co-processor for input, audio, and wireless.

	  This port targets DSi mode only. Booting requires an Unlaunch-
	  capable console (or a signed loader) and a small NDS-format
	  shim that loads the kernel into RAM and jumps to its entry.

if ARCH_TWL

config MACH_NINTENDO_TWL
	bool "Nintendo DSi (TWL/CTR family)"
	default y
	help
	  Default DSi machine. There is currently only one variant.

endif
```
