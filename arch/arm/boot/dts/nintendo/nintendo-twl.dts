// SPDX-License-Identifier: GPL-2.0
//
// nintendo-twl.dts — board file for the Nintendo DSi (DSi mode, 16 MB RAM).

/dts-v1/;
#include "nintendo-twl.dtsi"

/ {
	model = "Nintendo DSi";
	compatible = "nintendo,twl";

	// DSi mode: 16 MB main RAM at 0x02000000.
	// (NDS backwards-compatibility mode has only 4 MB here.)
	memory@2000000 {
		device_type = "memory";
		reg = <0x02000000 0x01000000>;
	};

	chosen {
		bootargs = "console=tty0 earlyprintk debug earlycon=ntr_nocash keep_bootcon rdinit=/sbin/init";
		stdout-path = &fb_sub;
		// Initramfs is embedded in the kernel Image via CONFIG_INITRAMFS_SOURCE.
	};
};
